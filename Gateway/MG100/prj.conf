## CMakeLists.txt
```
# SPDX-License-Identifier: Apache-2.0

cmake_minimum_required(VERSION 3.20.0)
find_package(Zephyr REQUIRED HINTS $ENV{ZEPHYR_BASE})
project(wiliot_gateway)

FILE(GLOB app_sources src/*.c)
target_sources(app PRIVATE ${app_sources})

add_definitions(-DDEBUG)

zephyr_library_include_directories("../../sdk/Interface")
zephyr_library_include_directories("../../sdk/sdkInc")
zephyr_library_include_directories("src")

target_sources(app PRIVATE src/osal/osal.c)
target_sources(app PRIVATE src/dev-if/dev-if.c)
target_sources(app PRIVATE src/modem-drv.c)
target_sources(app PRIVATE src/network-api.c)
target_sources(app PRIVATE src/flash-drv.c)
target_sources(app PRIVATE ../../sdk/sdkSrc/cJSON.c)
target_sources(app PRIVATE ../../sdk/sdkSrc/logger.c)
target_sources(app PRIVATE ../../sdk/sdkSrc/williotSdkJson.c)
target_sources(app PRIVATE ../../sdk/sdkSrc/upLink.c)
target_sources(app PRIVATE ../../sdk/sdkSrc/downLink.c)
target_sources(app PRIVATE ../../sdk/sdkSrc/sdkConfigurations.c)
target_sources(app PRIVATE ../../sdk/sdkSrc/mqttTopics.c)
target_sources(app PRIVATE ../../sdk/sdkSrc/networkManager.c)
target_sources(app PRIVATE ../../sdk/sdkSrc/serviceDiscovery.c)
```

## prj.conf
```kconfig
CONFIG_BT=y
CONFIG_BT_BROADCASTER=y
CONFIG_BT_OBSERVER=y
CONFIG_BT_DEBUG_LOG=y
CONFIG_BT_DEVICE_NAME="GatewayOfhappiness"
CONFIG_HEAP_MEM_POOL_SIZE=8192
CONFIG_UART_INTERRUPT_DRIVEN=y
CONFIG_ASSERT=y
CONFIG_EVENTS=y
CONFIG_NEWLIB_LIBC=y
CONFIG_NEWLIB_LIBC_FLOAT_PRINTF=y

CONFIG_FLASH=y
CONFIG_FLASH_MAP=y
CONFIG_MPU_ALLOW_FLASH_WRITE=y
# dts node mx25r64 relevant, this is some extra flash feature of mg100
CONFIG_NORDIC_QSPI_NOR=y
CONFIG_NORDIC_QSPI_NOR_FLASH_LAYOUT_PAGE_SIZE=4096
CONFIG_NORDIC_QSPI_NOR_STACK_WRITE_BUFFER_SIZE=16

# Networking
CONFIG_NETWORKING=y
CONFIG_NET_IPV4=y
CONFIG_NET_TCP=y
CONFIG_NET_SOCKETS=y
CONFIG_NET_SOCKETS_POSIX_NAMES=y
# DNS resolver
CONFIG_DNS_RESOLVER=y
# should be 10 seconds minimum, but allow more time for modem to wakeup
CONFIG_NET_SOCKETS_DNS_TIMEOUT=20000
# TLS
CONFIG_MBEDTLS=y
CONFIG_MBEDTLS_BUILTIN=y
CONFIG_MBEDTLS_ENABLE_HEAP=y
CONFIG_MBEDTLS_HEAP_SIZE=80000
CONFIG_MBEDTLS_SSL_MAX_CONTENT_LEN=16384
CONFIG_NET_SOCKETS_SOCKOPT_TLS=y
# NETWORK MANAGEMENT
CONFIG_NET_MGMT=y
CONFIG_NET_MGMT_EVENT=y

# MQTT
CONFIG_MQTT_LIB=y
CONFIG_MQTT_LIB_TLS=y
CONFIG_MQTT_CLEAN_SESSION=y
CONFIG_MQTT_KEEPALIVE=120

# Modem settings
CONFIG_MODEM=y
CONFIG_MODEM_HL7800=y
CONFIG_MODEM_HL7800_BOOT_DELAY=y
CONFIG_MODEM_HL7800_RAT_M1=y
CONFIG_MODEM_HL7800_RAT_NB1=n
CONFIG_MODEM_HL7800_CONFIGURE_BANDS=n

# HTTP
# CONFIG_HTTP_CLIENT=y experimental

# Logs
# CONFIG_UART_CONSOLE=y
# CONFIG_LOG_BACKEND_UART=y
# CONFIG_NET_LOG=y
# CONFIG_MBEDTLS_LOG_LEVEL_DBG=y
# CONFIG_MODEM_LOG_LEVEL_DBG=y
```

## mg100.overlay
```dts
// To get started, press Ctrl+Space to bring up the completion menu and view the available nodes.
// You can also use the buttons in the sidebar to perform actions on nodes.
// Actions currently available include:

// * Enabling / disabling the node
// * Adding the bus to a bus
// * Removing the node
// * Connecting ADC channels

// For more help, browse the DeviceTree documentation at https://docs.zephyrproject.org/latest/guides/dts/index.html
// You can also visit the nRF DeviceTree extension documentation at https://nrfconnect.github.io/vscode-nrf-connect/devicetree/nrfdevicetree.html


/ {
    aliases {
        modem-uart = &uart1;
        gpio-0 = &gpio0;
        storage = &storage_partition;
    };
};

// &mx25r64 {
//     status = "disabled"; // can be enabled together with CONFIG_NORDIC_QSPI_NOR. Needed?
// };
```

## src/flash-drv.c
```c
#include <zephyr/drivers/flash.h>
#include <zephyr/storage/flash_map.h>

#include "flash-drv.h"

const static struct flash_area * s_storageArea = NULL;

inline static off_t getPageOffset(eFlashPage flashPage)
{
    return (off_t)(SIZE_OF_FLASH_PAGE * flashPage);
}

SDK_STAT FlashInit()
{
    int err = 0;
    static bool isFlashOpen = false;
 
    if(!isFlashOpen)
    {
        err = flash_area_open(DT_FIXED_PARTITION_ID(DT_ALIAS(storage)), &s_storageArea);
        isFlashOpen = true;
    }

    return (err ? SDK_FAILURE : SDK_SUCCESS);
}

SDK_STAT FlashRead(eFlashPage flashPage, void * savePageAdd)
{
    if(!savePageAdd || (flashPage >= FLASH_PAGE_NUM)) // recheck this maybe error
    {
        return SDK_INVALID_PARAMS;
    }

    int err = flash_area_read(s_storageArea, getPageOffset(flashPage), savePageAdd, SIZE_OF_FLASH_PAGE);
    if(err)
    {
        return SDK_FAILURE;
    }

    return SDK_SUCCESS;
}

SDK_STAT FlashWrite(eFlashPage flashPage, const void * loadStrAdd, size_t sizeOfLoadStr)
{
    if(!loadStrAdd || (flashPage >= FLASH_PAGE_NUM)) // recheck this maybe error
    {
        return SDK_INVALID_PARAMS;
    }

    int ans = flash_area_write(s_storageArea, getPageOffset(flashPage), loadStrAdd, sizeOfLoadStr);
    if(ans)
    {
        return SDK_FAILURE;
    }

    return SDK_SUCCESS;
}

SDK_STAT FlashErase(eFlashPage flashPage)
{
    int ans = flash_area_erase(s_storageArea, getPageOffset(flashPage), SIZE_OF_FLASH_PAGE);
    if(ans)
    {
        return SDK_FAILURE;
    }

    return SDK_SUCCESS;
}
```

## src/modem-drv.c
```c
#include <zephyr/kernel.h>
#include <zephyr/drivers/modem/hl7800.h>

#include "modem-drv.h"
#include "logger.h"

static void modemDeviceStart()
{
    int status = 0;

    printk("Starting modem\n");

    status = mdm_hl7800_reset();
    if (status != 0)
    {
        printk("Failed resetting modem\n");
    }
}

SDK_STAT ModemInit(ReadModemDataCB cb) 
{
    modemDeviceStart();

    return SDK_SUCCESS;
}
```
